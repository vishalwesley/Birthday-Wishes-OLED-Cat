#include <Wire.h>
#include <Adafruit_GFX.h>
#include <Adafruit_SSD1306.h>

#define SCREEN_WIDTH 128
#define SCREEN_HEIGHT 64

// OLED 1 (Cat)
TwoWire I2Ccat = TwoWire(0);
Adafruit_SSD1306 catDisplay(
  SCREEN_WIDTH,
  SCREEN_HEIGHT,
  &I2Ccat,
  -1
);

// OLED 2 (Text)
TwoWire I2Ctext = TwoWire(1);
Adafruit_SSD1306 textDisplay(
  SCREEN_WIDTH,
  SCREEN_HEIGHT,
  &I2Ctext,
  -1
);


// =====================================================
const unsigned char cat_happy [] PROGMEM = {
	// 'Screenshot 2026-06-28 113016, 128x64px
	0x00, 0x00, 0x00, 0x00, 0x00, 0x00, 0x00, 0x00, 0x00, 0x00, 0x00, 0x00, 0x00, 0x00, 0x00, 0x00, 
	0x00, 0x00, 0x00, 0x00, 0x00, 0x00, 0x00, 0x00, 0x00, 0x00, 0x00, 0x00, 0x00, 0x00, 0x00, 0x00, 
	0x00, 0x00, 0x00, 0x00, 0x00, 0x00, 0x00, 0x00, 0x00, 0x00, 0x00, 0x00, 0x00, 0x00, 0x00, 0x00, 
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	0x00, 0x00, 0x00, 0x00, 0x00, 0x00, 0x00, 0x00, 0x00, 0x00, 0x00, 0x00, 0x00, 0x00, 0x00, 0x00
};

// =====================================================



// =====================================================
const unsigned char cat_wink [] PROGMEM = {
	// 'Screenshot 2026-06-28 113231, 128x64px
	0x00, 0x00, 0x00, 0x00, 0x00, 0x00, 0x00, 0x00, 0x00, 0x00, 0x00, 0x00, 0x00, 0x00, 0x00, 0x00, 
	0x00, 0x00, 0x00, 0x00, 0x00, 0x00, 0x00, 0x00, 0x00, 0x00, 0x00, 0x00, 0x00, 0x00, 0x00, 0x00, 
	0x00, 0x00, 0x00, 0x00, 0x00, 0x00, 0x00, 0x00, 0x00, 0x00, 0x00, 0x00, 0x00, 0x00, 0x00, 0x00, 
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	0x00, 0x00, 0x00, 0x00, 0x00, 0x00, 0x00, 0x00, 0x00, 0x00, 0x00, 0x00, 0x00, 0x00, 0x00, 0x00
};
// =====================================================



const unsigned char* frames[] = {
  cat_happy,
  cat_wink
};

const int numFrames = 2;
int frame = 0;

void setup() {
  I2Ccat.begin(8, 9);      // SDA, SCL
  I2Ctext.begin(21, 47);   // SDA, SCL

  if (!catDisplay.begin(SSD1306_SWITCHCAPVCC, 0x3C)) {
    while (1);
  }

  if (!textDisplay.begin(SSD1306_SWITCHCAPVCC, 0x3C)) {
    while (1);
  }

  catDisplay.clearDisplay();
  textDisplay.clearDisplay();
}

void loop() {

  // -------- CAT DISPLAY --------
  catDisplay.clearDisplay();

  catDisplay.drawBitmap(
    0,
    0,
    frames[frame],
    128,
    64,
    WHITE
  );

  catDisplay.display();

  frame++;
  if (frame >= numFrames)
    frame = 0;


  // -------- TEXT DISPLAY --------
static int msg = 0;

textDisplay.clearDisplay();
textDisplay.setTextColor(WHITE);

if (msg == 0) {
  textDisplay.setTextSize(2);
  textDisplay.setCursor(0, 25);
  textDisplay.println("THANK YOU!");
}
else if (msg == 1) {
  textDisplay.setTextSize(1);
  textDisplay.setCursor(25, 20);
  textDisplay.println("YOU MADE");
  textDisplay.setCursor(35, 38);
  textDisplay.println("MY DAY");
}
else {
  textDisplay.setTextSize(1);
  textDisplay.setCursor(45, 20);
  textDisplay.println("LOVE");
  textDisplay.setCursor(35, 38);
  textDisplay.println("Y'ALL");
}

textDisplay.display();

msg++;
if (msg > 2)
  msg = 0;

delay(1500);
}